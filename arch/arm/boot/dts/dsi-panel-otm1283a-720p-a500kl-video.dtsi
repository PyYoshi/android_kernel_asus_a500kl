/* Copyright (c) 2013, The Linux Foundation. All rights reserved.
 *
 * This program is free software; you can redistribute it and/or modify
 * it under the terms of the GNU General Public License version 2 and
 * only version 2 as published by the Free Software Foundation.
 *
 * This program is distributed in the hope that it will be useful,
 * but WITHOUT ANY WARRANTY; without even the implied warranty of
 * MERCHANTABILITY or FITNESS FOR A PARTICULAR PURPOSE.  See the
 * GNU General Public License for more details.
 */

/*---------------------------------------------------------------------------
 * This file is autogenerated file using gcdb parser. Please do not edit it.
 * Update input XML file to add a new entry or update variable in this file
 * VERSION = "1.0"
 *---------------------------------------------------------------------------*/
&mdss_mdp {
dsi_a500kl_720_vid: qcom,mdss_dsi_a500kl_720p_video {
		qcom,mdss-dsi-panel-name = "a500kl 720p video mode dsi panel";
		qcom,mdss-dsi-panel-controller = <&mdss_dsi0>;
		qcom,mdss-dsi-panel-type = "dsi_video_mode";
		qcom,mdss-dsi-panel-destination = "display_1";
		qcom,mdss-dsi-panel-framerate = <60>;
		qcom,mdss-dsi-virtual-channel-id = <0>;
		qcom,mdss-dsi-stream = <0>;
		qcom,mdss-dsi-panel-width = <720>;
		qcom,mdss-dsi-panel-height = <1280>;
		qcom,mdss-dsi-h-front-porch = <64>;
		qcom,mdss-dsi-h-back-porch = <48>;
		qcom,mdss-dsi-h-pulse-width = <18>;
		qcom,mdss-dsi-h-sync-skew = <0>;
		qcom,mdss-dsi-v-back-porch = <14>;
		qcom,mdss-dsi-v-front-porch = <9>;
		qcom,mdss-dsi-v-pulse-width = <3>;
		qcom,mdss-dsi-h-left-border = <0>;
		qcom,mdss-dsi-h-right-border = <0>;
		qcom,mdss-dsi-v-top-border = <0>;
		qcom,mdss-dsi-v-bottom-border = <0>;
		qcom,mdss-dsi-bpp = <24>;
		qcom,mdss-dsi-color-order = <0>;
		qcom,mdss-dsi-underflow-color = <0xff>;
		qcom,mdss-dsi-border-color = <0>;
		qcom,mdss-dsi-pixel-packing = <0>;
		qcom,mdss-dsi-on-command = [	
				23 01 00 00 00 00 02 00 00
 				29 01 00 00 00 00 04 FF 12 83 01
				23 01 00 00 00 00 02 00 80					
 		 		29 01 00 00 00 00 03 FF 12 83
				23 01 00 00 00 00 02 00 80		
 		 		29 01 00 00 00 00 08 C0 00 64 00 10 10 00 64
				23 01 00 00 00 00 02 00 87 		
 		     	29 01 00 00 00 00 03 C0 10 10 
				23 01 00 00 00 00 02 00 90
 		 		29 01 00 00 00 00 07 C0 00 56 00 01 00 04 
				23 01 00 00 00 00 02 00 A2
 				23 01 00 00 00 00 02 C0 00             
              	23 01 00 00 00 00 02 00 A3                                                    		
 				23 01 00 00 00 00 02 C0 15 		
 				23 01 00 00 00 00 02 00 A4									
 				23 01 00 00 00 00 02 C0 10		
				23 01 00 00 00 00 02 00 B3									
				29 01 00 00 00 00 03 C0 00 50
				23 01 00 00 00 00 02 00 81
 				23 01 00 00 00 00 02 C1 55
				23 01 00 00 00 00 02 00 90
 				23 01 00 00 00 00 02 C4 49   	
    			23 01 00 00 00 00 02 00 B4
				23 01 00 00 00 00 02 C0 55
 				23 01 00 00 00 00 02 00 00
        		23 01 00 00 00 00 02 36 00		
				23 01 00 00 00 00 02 00 A0		
				29 01 00 00 00 00 08 C4 05 10 06 02 05 15 10
				23 01 00 00 00 00 02 00 A7		
				29 01 00 00 00 00 08 C4 05 10 07 02 05 15 10
				23 01 00 00 00 00 02 00 B0
				29 01 00 00 00 00 03 C4 00 00
				23 01 00 00 00 00 02 00 91
				29 01 00 00 00 00 03 C5 46 40
				23 01 00 00 00 00 02 00 00
				29 01 00 00 00 00 03 D8 CF CF					       											                           
                23 01 00 00 00 00 02 00 81
 				23 01 00 00 00 00 02 C4 82
				23 01 00 00 00 00 02 00 B0		
				29 01 00 00 00 00 03 C5 04 B8
				23 01 00 00 00 00 02 00 BB
 				23 01 00 00 00 00 02 C5 80
				23 01 00 00 00 00 02 00 82
 				23 01 00 00 00 00 02 C4 02
				23 01 00 00 00 00 02 00 C6
 				23 01 00 00 00 00 02 B0 03
//				23 01 00 00 00 00 02 00 00//Removed by Hanstar 2014612
//				23 01 00 00 00 00 02 D0 40//Removed by Hanstar 2014612
//				23 01 00 00 00 00 02 00 00//Removed by Hanstar 2014612
//				29 01 00 00 00 00 03 D1 00 00//Removed by Hanstar 2014612
				23 01 00 00 00 00 02 00 80
				29 01 00 00 00 00 08 CB 00 00 00 00 00 00 00      
	    		23 01 00 00 00 00 02 00 87
				29 01 00 00 00 00 05 CB 00 00 00 00
				23 01 00 00 00 00 02 00 90
				29 01 00 00 00 00 08 CB 00 00 00 00 00 00 00
	    		23 01 00 00 00 00 02 00 97
				29 01 00 00 00 00 08 CB 00 00 00 00 00 00 00
        		23 01 00 00 00 00 02 00 9E
 		 		29 01 00 00 00 00 02 CB 00
				23 01 00 00 00 00 02 00 A0
 		 		29 01 00 00 00 00 08 CB 00 00 00 00 00 00 00
	    		23 01 00 00 00 00 02 00 A7
 		 		29 01 00 00 00 00 08 CB 00 00 00 00 00 00 00
        		23 01 00 00 00 00 02 00 AE
 		 		29 01 00 00 00 00 02 CB 00
				23 01 00 00 00 00 02 00 B0
 		 		29 01 00 00 00 00 08 CB 00 00 00 00 00 00 00
	    		23 01 00 00 00 00 02 00 B7
 		 		29 01 00 00 00 00 08 CB 00 00 00 00 00 00 00
        		23 01 00 00 00 00 02 00 BE
 		 		29 01 00 00 00 00 02 CB 00
				23 01 00 00 00 00 02 00 C0
 		 		29 01 00 00 00 00 08 CB 05 05 05 05 05 05 00
	    		23 01 00 00 00 00 02 00 C7
 		 		29 01 00 00 00 00 08 CB 00 00 00 05 05 00 05
       			23 01 00 00 00 00 02 00 CE
 		 		29 01 00 00 00 00 02 CB 05
				23 01 00 00 00 00 02 00 D0
 		 		29 01 00 00 00 00 08 CB 00 00 00 00 00 00 00    
	    		23 01 00 00 00 00 02 00 D7
 		 		29 01 00 00 00 00 08 CB 05 05 05 05 05 05 00 
        		23 01 00 00 00 00 02 00 DE
 		 		29 01 00 00 00 00 02 CB 00
				23 01 00 00 00 00 02 00 E0    		
 		 		29 01 00 00 00 00 08 CB 00 00 05 05 00 05 05
	    		23 01 00 00 00 00 02 00 E7
 		 		29 01 00 00 00 00 08 CB 00 00 00 00 00 00 00
				23 01 00 00 00 00 02 00 F0		
 		 		29 01 00 00 00 00 08 CB FF FF FF FF FF FF FF    
				23 01 00 00 00 00 02 00 F7
				//29 01 00 00 00 00 05 CB FF FF FF 00 //Wrong 20140314
				29 01 00 00 00 00 05 CB FF FF FF FF //Correct by Hannstar 20140314
				23 01 00 00 00 00 02 00 80     
 			 	29 01 00 00 00 00 08 CC 0E 10 0A 0C 02 04 00	        
	        	23 01 00 00 00 00 02 00 87			
 			 	29 01 00 00 00 00 08 CC 00 00 00 2E 2D 00 29
				23 01 00 00 00 00 02 00 8E			
 			 	29 01 00 00 00 00 02 CC 2A
				23 01 00 00 00 00 02 00 90
 			 	29 01 00 00 00 00 08 CC 00 00 00 00 00 00 00              
	        	23 01 00 00 00 00 02 00 97			
 			 	29 01 00 00 00 00 08 CC 0D 0F 09 0B 01 03 00        	
        		23 01 00 00 00 00 02 00 9E 
 			 	29 01 00 00 00 00 02 CC 00
				23 01 00 00 00 00 02 00 A0
 			 	29 01 00 00 00 00 08 CC 00 00 2E 2D 00 29 2A       	
        		23 01 00 00 00 00 02 00 A7
 			 	29 01 00 00 00 00 08 CC 00 00 00 00 00 00 00
				23 01 00 00 00 00 02 00 B0
 			 	29 01 00 00 00 00 08 CC 0B 09 0F 0D 03 01 00       	        
	        	23 01 00 00 00 00 02 00 B7
 			 	29 01 00 00 00 00 08 CC 00 00 00 2D 2E 00 29
        		23 01 00 00 00 00 02 00 BE
 			 	29 01 00 00 00 00 02 CC 2A
				23 01 00 00 00 00 02 00 C0			
 			 	29 01 00 00 00 00 08 CC 00 00 00 00 00 00 00
	        	23 01 00 00 00 00 02 00 C7
 			 	29 01 00 00 00 00 08 CC 0C 0A 10 0E 04 02 00
        		23 01 00 00 00 00 02 00 CE
 			 	29 01 00 00 00 00 02 CC 00
				23 01 00 00 00 00 02 00 D0			
 			 	29 01 00 00 00 00 08 CC 00 00 2D 2E 00 29 2A      
	        	23 01 00 00 00 00 02 00 D7
 			 	29 01 00 00 00 00 08 CC 00 00 00 00 00 00 00
				23 01 00 00 00 00 02 00 80			
 			 	29 01 00 00 00 00 08 CE 8B 03 18 8A 03 18 89
	        	23 01 00 00 00 00 02 00 87
 			 	29 01 00 00 00 00 06 CE 03 18 88 03 18
				23 01 00 00 00 00 02 00 90
 			 	29 01 00 00 00 00 08 CE 00 00 00 00 00 00 00	        
	        	23 01 00 00 00 00 02 00 97
 			 	29 01 00 00 00 00 08 CE 00 00 00 00 00 00 00
				23 01 00 00 00 00 02 00 A0 
 			 	29 01 00 00 00 00 08 CE 38 07 05 00 00 18 00 	        
	        	23 01 00 00 00 00 02 00 A7
 			 	29 01 00 00 00 00 08 CE 38 06 05 01 00 18 00
				23 01 00 00 00 00 02 00 B0			
 			 	29 01 00 00 00 00 08 CE 38 05 05 02 00 18 00
	        	23 01 00 00 00 00 02 00 B7
 			 	29 01 00 00 00 00 08 CE 38 04 05 03 00 18 00       	
        		23 01 00 00 00 00 02 00 C0
 			 	29 01 00 00 00 00 08 CE 38 03 05 04 00 18 00
	        	23 01 00 00 00 00 02 00 C7			
 			 	29 01 00 00 00 00 08 CE 38 02 05 05 00 18 00       	
        		23 01 00 00 00 00 02 00 D0 			
 			 	29 01 00 00 00 00 08 CE 38 01 05 06 00 18 00
	        	23 01 00 00 00 00 02 00 D7
 			 	29 01 00 00 00 00 08 CE 38 00 05 07 00 18 00
				23 01 00 00 00 00 02 00 80
 			 	29 01 00 00 00 00 08 CF 00 00 00 00 00 00 00
	        	23 01 00 00 00 00 02 00 87			
 			 	29 01 00 00 00 00 08 CF 00 00 00 00 00 00 00
				23 01 00 00 00 00 02 00 90			
 			 	29 01 00 00 00 00 08 CF 00 00 00 00 00 00 00
	        	23 01 00 00 00 00 02 00 97
 			 	29 01 00 00 00 00 08 CF 00 00 00 00 00 00 00
				23 01 00 00 00 00 02 00 A0   
 			 	29 01 00 00 00 00 08 CF 00 00 00 00 00 00 00
	        	23 01 00 00 00 00 02 00 A7			
 			 	29 01 00 00 00 00 08 CF 00 00 00 00 00 00 00
				23 01 00 00 00 00 02 00 B0
 			 	29 01 00 00 00 00 08 CF 00 00 00 00 00 00 00    
	        	23 01 00 00 00 00 02 00 B7
 			 	29 01 00 00 00 00 08 CF 00 00 00 00 00 00 00 
				23 01 00 00 00 00 02 00 C0
 			 	29 01 00 00 00 00 08 CF 3D 02 15 20 00 00 01      
				23 01 00 00 00 00 02 00 C7
				29 01 00 00 00 00 05 CF 80 00 03 08
				23 01 00 00 00 00 02 00 B5		
				29 01 00 00 00 00 07 C5 00 6F FF 00 6F FF     	
				23 01 00 00 00 00 02 00 90		
				29 01 00 00 00 00 05 F5 02 11 02 11
				23 01 00 00 00 00 02 00 90
				//23 01 00 00 00 00 02 00 50 //Wrong 20140314
				23 01 00 00 00 00 02 C5 50 //Correct by Hannstar 20140314
				23 01 00 00 00 00 02 00 94
				23 01 00 00 00 00 02 C5 66
				23 01 00 00 00 00 02 00 B2 			
 			 	29 01 00 00 00 00 03 F5 00 00       
				23 01 00 00 00 00 02 00 B4    
 			 	29 01 00 00 00 00 03 F5 00 00
				23 01 00 00 00 00 02 00 B6   
 			 	29 01 00 00 00 00 03 F5 00 00
				23 01 00 00 00 00 02 00 B8  
 			 	29 01 00 00 00 00 03 F5 00 00
				23 01 00 00 00 00 02 00 94
				23 01 00 00 00 00 02 F5 02
				23 01 00 00 00 00 02 00 BA
				23 01 00 00 00 00 02 F5 03
				23 01 00 00 00 00 02 00 B4
				23 01 00 00 00 00 02 C5 C0		
//------------------Gamma setting------------------//					
				23 01 00 00 00 00 02 00 00
				29 01 00 00 00 00 08 E1 00 0C 12 0D 06 0E 0A 
				29 01 00 00 00 00 08 E1 09 05 07 0F 09 10 12
				29 01 00 00 00 00 03 E1 0D 00
				23 01 00 00 00 00 02 00 00
				29 01 00 00 00 00 08 E2 00 0C 12 0D 06 0E 0A
				29 01 00 00 00 00 08 E2 09 05 07 0F 09 10 12
				29 01 00 00 00 00 03 E2 0D 00
//===========================================================
				23 01 00 00 00 00 02 00 00				//New for ESD improvement 20140314
				29 01 00 00 00 00 04 FF FF FF FF  //New for ESD improvement 20140314

				13 01 00 00 96 00 01 11		
				13 01 00 00 0A 00 01 29
		];

		qcom,mdss-dsi-off-command = [05 01 00 00 32 00 02 28 00
				 05 01 00 00 78 00 02 10 00];
		qcom,mdss-dsi-on-command-state = "dsi_lp_mode";
		qcom,mdss-dsi-off-command-state = "dsi_hs_mode";
		qcom,mdss-dsi-h-sync-pulse = <1>;
		qcom,mdss-dsi-traffic-mode = <2>;
		qcom,mdss-dsi-lane-map = <0>;
		qcom,mdss-dsi-bllp-eof-power-mode;
		qcom,mdss-dsi-bllp-power-mode;
		qcom,mdss-dsi-lane-0-state;
		qcom,mdss-dsi-lane-1-state;
		qcom,mdss-dsi-lane-2-state;
		qcom,mdss-dsi-lane-3-state;
		qcom,mdss-dsi-panel-timings = [78 18 10 00 3A 3E 14 1C 12 03 04 00];
		qcom,mdss-dsi-t-clk-post = <0x20>;
		qcom,mdss-dsi-t-clk-pre = <0x2c>;
		qcom,mdss-dsi-bl-min-level = <1>;
		qcom,mdss-dsi-bl-max-level = <255>;
		qcom,mdss-dsi-dma-trigger = <4>;
		qcom,mdss-dsi-mdp-trigger = <0>;
		qcom,mdss-dsi-reset-sequence = <1 20>, <0 30>, <1 20>;
		qcom,mdss-dsi-bl-pmic-control-type = "bl_ctrl_wled";
		qcom,mdss-dsi-bl-pmic-bank-select = <0>;
		qcom,mdss-dsi-bl-pmic-pwm-frequency = <1615>;
		qcom,mdss-pan-physical-width-dimension = <62>;
		qcom,mdss-pan-physical-height-dimension = <110>;
	};
};
