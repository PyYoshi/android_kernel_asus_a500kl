## drivers/power/charger/Kconfig
```kconfig
config SMB_346_CHARGER
        bool "Support for Maxim 8934 charger"

config DUMMY_CHARGER
        bool "Support for dummy charger"

config PM_8921_CHARGER
        bool "Support for PM 8921 charger"

config PM_8226_CHARGER
        bool "Support for PM 8226 charger"
```

## drivers/sensors/Kconfig
```kconfig
menu "Sensors driver"

config SENSORS_PROXM
	tristate "PS ALS proxm_class support"
	depends on I2C=y
	help
	  ASUS SENSORS folder

config SENSORS_CM36283
	tristate "PS ALS CM36283 support"
	depends on I2C=y
	help
	  ASUS SENSORS folder

endmenu
```
